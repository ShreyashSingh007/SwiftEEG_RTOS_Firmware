## CMakeLists.txt
```
cmake_minimum_required(VERSION 3.20.0)

list(APPEND BOARD_ROOT ${CMAKE_CURRENT_SOURCE_DIR}/../..)
list(APPEND DTS_ROOT   ${CMAKE_CURRENT_SOURCE_DIR}/../..)

find_package(Zephyr REQUIRED HINTS $ENV{ZEPHYR_BASE})
project(proto_test LANGUAGES C)

target_sources(app PRIVATE
  src/main.c
  ${CMAKE_CURRENT_SOURCE_DIR}/../../src/proto/proto.c
)

# proto.h lives with the source; golden_vectors.h is generated next to us.
target_include_directories(app PRIVATE
  ${CMAKE_CURRENT_SOURCE_DIR}/../../src/proto
  ${CMAKE_CURRENT_SOURCE_DIR}
)

target_compile_options(app PRIVATE -Wall -Wextra -Werror)
```

## prj.conf
```kconfig
CONFIG_ZTEST=y

# Results go out over RTT - this board has no spare UART.
CONFIG_LOG=y
CONFIG_LOG_MODE_IMMEDIATE=y
CONFIG_USE_SEGGER_RTT=y
CONFIG_RTT_CONSOLE=y
CONFIG_CONSOLE=y

CONFIG_MAIN_STACK_SIZE=4096
CONFIG_ZTEST_STACK_SIZE=4096

# ztest output can exceed the 1 KB default before a host attaches to RTT.
# SEGGER RTT drops on overflow in the default skip mode, which would silently
# truncate the results, so give the up-buffer real room.
CONFIG_SEGGER_RTT_BUFFER_SIZE_UP=8192
```

## src/main.c
```c
/*
 * Protocol codec tests.
 *
 * The C codec is checked against golden vectors generated by
 * tools/proto_ref.py. That Python module is the authoritative definition of
 * the wire format; if these disagree, the C side is wrong.
 *
 * Run on target:
 *   west build -b swifteeg tests/proto && west flash
 */

#include <zephyr/ztest.h>

#include <string.h>

#include "proto.h"
#include "golden_vectors.h"

ZTEST(proto, test_crc_check_value)
{
	/* The standard CRC-16/CCITT-FALSE check value pins the algorithm. */
	zassert_equal(proto_crc16((const uint8_t *)"123456789", 9),
		      GOLDEN_CRC_CHECK,
		      "CRC does not match the CCITT-FALSE check value");
}

ZTEST(proto, test_encode_matches_golden)
{
	uint8_t buf[PROTO_MAX_FRAME];

	for (size_t i = 0; i < GOLDEN_VECTOR_COUNT; i++) {
		const struct golden_vector *v = &golden_vectors[i];

		int n = proto_encode(v->type, v->flags, v->seq,
				     v->payload, v->payload_len,
				     buf, sizeof(buf));

		zassert_equal(n, (int)v->frame_len,
			      "%s: encoded length %d, expected %u",
			      v->name, n, v->frame_len);
		zassert_mem_equal(buf, v->frame, v->frame_len,
				  "%s: encoded bytes differ from reference",
				  v->name);
	}
}

ZTEST(proto, test_decode_matches_golden)
{
	for (size_t i = 0; i < GOLDEN_VECTOR_COUNT; i++) {
		const struct golden_vector *v = &golden_vectors[i];
		proto_frame_t f;

		zassert_equal(proto_decode(v->frame, v->frame_len, &f), PROTO_OK,
			      "%s: decode failed", v->name);
		zassert_equal(f.type, v->type, "%s: type", v->name);
		zassert_equal(f.flags, v->flags, "%s: flags", v->name);
		zassert_equal(f.seq, v->seq, "%s: seq", v->name);
		zassert_equal(f.len, v->payload_len, "%s: len", v->name);

		if (v->payload_len) {
			zassert_mem_equal(f.payload, v->payload, v->payload_len,
					  "%s: payload", v->name);
		}
	}
}

ZTEST(proto, test_decode_rejects_corruption)
{
	/* Every single-byte corruption in a frame must be caught. */
	const struct golden_vector *v = &golden_vectors[3];
	uint8_t buf[PROTO_MAX_FRAME];

	for (uint16_t pos = 0; pos < v->frame_len; pos++) {
		memcpy(buf, v->frame, v->frame_len);
		buf[pos] ^= 0x01;

		proto_frame_t f;
		int err = proto_decode(buf, v->frame_len, &f);

		zassert_not_equal(err, PROTO_OK,
				  "corruption at byte %u went undetected", pos);
	}
}

ZTEST(proto, test_encode_rejects_bad_args)
{
	uint8_t buf[PROTO_MAX_FRAME];
	uint8_t payload[4] = { 1, 2, 3, 4 };

	zassert_equal(proto_encode(0x7F, 0, 0, payload, 4, buf, sizeof(buf)),
		      PROTO_ERR_TYPE, "bad type accepted");
	zassert_equal(proto_encode(PROTO_TYPE_CMD, 0, 0, payload, 4, buf, 4),
		      PROTO_ERR_SPACE, "undersized buffer accepted");
	zassert_equal(proto_encode(PROTO_TYPE_CMD, 0, 0, payload,
				   PROTO_MAX_PAYLOAD + 1, buf, sizeof(buf)),
		      PROTO_ERR_ARG, "oversized payload accepted");
	zassert_equal(proto_encode(PROTO_TYPE_CMD, 0, 0, NULL, 4,
				   buf, sizeof(buf)),
		      PROTO_ERR_ARG, "null payload with nonzero length accepted");
}

ZTEST(proto, test_data_dsp_invalid_flag_roundtrips)
{
	uint8_t buf[PROTO_MAX_FRAME];
	const uint8_t payload[] = { 0x04, 0x00 };

	const int n = proto_encode(PROTO_TYPE_DATA, PROTO_FLAG_DSP_INVALID,
				   17, payload, sizeof(payload), buf, sizeof(buf));
	zassert_true(n > 0, "DATA frame with DSP flag did not encode");

	proto_frame_t f;
	zassert_equal(proto_decode(buf, (size_t)n, &f), PROTO_OK,
		      "DATA frame with DSP flag did not decode");
	zassert_equal(f.flags, PROTO_FLAG_DSP_INVALID,
		      "DSP invalid flag was not preserved");
}

ZTEST(proto, test_stream_decodes_back_to_back)
{
	proto_stream_t st;
	proto_frame_t f;
	uint8_t buf[PROTO_MAX_FRAME];

	proto_stream_reset(&st);

	for (size_t i = 0; i < GOLDEN_VECTOR_COUNT; i++) {
		const struct golden_vector *v = &golden_vectors[i];
		bool got = false;

		for (uint16_t b = 0; b < v->frame_len; b++) {
			got = proto_stream_push(&st, v->frame[b], &f);
			/* A frame must only complete on its final byte. */
			if (b < v->frame_len - 1) {
				zassert_false(got, "%s: completed early at %u",
					      v->name, b);
			}
		}

		zassert_true(got, "%s: stream never completed", v->name);
		zassert_equal(f.seq, v->seq, "%s: seq", v->name);
		zassert_equal(f.len, v->payload_len, "%s: len", v->name);
	}

	(void)buf;
	zassert_equal(st.crc_errors, 0, "unexpected CRC errors");
}

ZTEST(proto, test_stream_resyncs_after_garbage)
{
	proto_stream_t st;
	proto_frame_t f;
	const struct golden_vector *v = &golden_vectors[4];

	proto_stream_reset(&st);

	/* Leading noise, including a false SOF, must not prevent recovery. */
	const uint8_t noise[] = { 0x00, 0xFF, 0xA5, 0x99, 0x12, 0xA5, 0x00 };
	for (size_t i = 0; i < sizeof(noise); i++) {
		(void)proto_stream_push(&st, noise[i], &f);
	}

	bool got = false;
	for (uint16_t b = 0; b < v->frame_len; b++) {
		got = proto_stream_push(&st, v->frame[b], &f);
	}

	zassert_true(got, "decoder failed to resync after garbage");
	zassert_equal(f.seq, v->seq, "seq after resync");
	zassert_mem_equal(f.payload, v->payload, v->payload_len,
			  "payload after resync");
}

ZTEST(proto, test_stream_survives_truncated_frame)
{
	proto_stream_t st;
	proto_frame_t f;
	const struct golden_vector *good = &golden_vectors[2];
	const struct golden_vector *cut = &golden_vectors[6];

	proto_stream_reset(&st);

	/*
	 * Half a frame, then good frames.
	 *
	 * The decoder CANNOT know the first frame was truncated until it has
	 * consumed the length that frame declared - so the bytes of the first
	 * good frame are legitimately swallowed making up that count. Only
	 * then does the CRC fail, and only then can it resync. Recovery is
	 * therefore measured as "a later good frame arrives", not "the very
	 * next one does".
	 */
	for (uint16_t b = 0; b < cut->frame_len / 2; b++) {
		(void)proto_stream_push(&st, cut->frame[b], &f);
	}

	bool got = false;
	for (int rep = 0; rep < 3 && !got; rep++) {
		for (uint16_t b = 0; b < good->frame_len; b++) {
			if (proto_stream_push(&st, good->frame[b], &f)) {
				got = true;
			}
		}
	}

	zassert_true(got, "decoder never recovered after a truncated frame");
	zassert_equal(f.seq, good->seq, "seq after truncation");
	zassert_equal(f.len, good->payload_len, "len after truncation");
	zassert_true(st.crc_errors >= 1,
		     "truncated frame should have produced a CRC error");
}

ZTEST(proto, test_stream_truncated_frame_preserves_distinct_payloads)
{
	proto_stream_t st;
	proto_frame_t f;

	/*
	 * Regression for R3-DSP-01: try_extract() used to consume() the just
	 * decoded frame - and clobber out->payload via the memmove - before
	 * returning it. Reusing the SAME frame three times (as the truncation
	 * test above does) cannot catch that, because the "clobbered" bytes
	 * are identical to the real ones. This uses three DIFFERENT frames so
	 * a leaked pointer shows up as the wrong payload, not just a wrong
	 * seq/len.
	 */
	const struct golden_vector *cut = &golden_vectors[6]; /* data_27b_frame: declares 27 bytes */
	const struct golden_vector *frames[3] = {
		&golden_vectors[2], /* evt_short */
		&golden_vectors[3], /* data_settling */
		&golden_vectors[5], /* data_seq_wrap */
	};
	uint8_t got_payload[3][16];
	uint16_t got_len[3] = { 0 };
	uint16_t got_seq[3] = { 0 };
	int got_count = 0;

	proto_stream_reset(&st);

	/*
	 * Only the header of `cut` arrives before the link drops the rest, so
	 * its declared 27-byte payload swallows the three good frames that
	 * follow. Once enough bytes have accumulated to match that declared
	 * length, the CRC fails and the decoder resyncs onto frames[0], which
	 * by then already has frames[1] (and part of frames[2]) buffered
	 * behind it - the exact pileup that let consume()'s memmove overwrite
	 * a payload before the caller could read it.
	 */
	for (uint16_t b = 0; b < PROTO_HEADER_LEN; b++) {
		zassert_false(proto_stream_push(&st, cut->frame[b], &f),
			      "cut header alone must not complete a frame");
	}

	for (int i = 0; i < 3; i++) {
		const struct golden_vector *v = frames[i];

		for (uint16_t b = 0; b < v->frame_len; b++) {
			if (proto_stream_push(&st, v->frame[b], &f)) {
				zassert_true(got_count < 3, "more frames than expected");
				/*
				 * Copy the payload out now, exactly as a real
				 * caller (command.c's handle()) must: before
				 * pushing or polling again. If it were still
				 * clobbered, this is where the wrong frame's
				 * bytes would show up.
				 */
				memcpy(got_payload[got_count], f.payload, f.len);
				got_len[got_count] = f.len;
				got_seq[got_count] = f.seq;
				got_count++;
			}
		}
	}

	/* Drain anything left buffered, same as the real transport does. */
	while (got_count < 3 && proto_stream_poll(&st, &f)) {
		memcpy(got_payload[got_count], f.payload, f.len);
		got_len[got_count] = f.len;
		got_seq[got_count] = f.seq;
		got_count++;
	}

	zassert_equal(got_count, 3, "expected exactly 3 frames out of the pileup");
	zassert_true(st.crc_errors >= 1,
		     "the swallowed length should have produced a CRC error");

	for (int i = 0; i < 3; i++) {
		const struct golden_vector *v = frames[i];

		zassert_equal(got_len[i], v->payload_len, "frame %d (%s): len", i, v->name);
		zassert_equal(got_seq[i], v->seq, "frame %d (%s): seq", i, v->name);
		zassert_mem_equal(got_payload[i], v->payload, v->payload_len,
				  "frame %d (%s): payload leaked a different frame's bytes",
				  i, v->name);
	}
}

ZTEST(proto, test_stream_poll_drains_buffered_frames)
{
	proto_stream_t st;
	proto_frame_t f;
	const struct golden_vector *v = &golden_vectors[2];

	proto_stream_reset(&st);

	/*
	 * Regression guard. resync() can re-anchor on a SOF with a COMPLETE
	 * frame already behind it; the decoder must parse that immediately
	 * rather than waiting for another byte that may never come.
	 */
	const uint8_t garbage[] = { 0xA5, 0x00, 0x00 };
	for (size_t i = 0; i < sizeof(garbage); i++) {
		(void)proto_stream_push(&st, garbage[i], &f);
	}

	bool got = false;
	for (uint16_t b = 0; b < v->frame_len; b++) {
		if (proto_stream_push(&st, v->frame[b], &f)) {
			got = true;
		}
	}

	zassert_true(got, "frame lost after a false SOF");
	zassert_equal(f.seq, v->seq, "seq wrong after false SOF");

	/* Nothing should remain once the frame has been taken. */
	zassert_false(proto_stream_poll(&st, &f), "poll returned a stale frame");
}

ZTEST_SUITE(proto, NULL, NULL, NULL, NULL, NULL);
```
